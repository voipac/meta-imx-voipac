## meta-voipac-bsp/conf/machine/imx8mq-voipac.conf
```bitbake
#@TYPE: Machine
#@NAME: Voipac i.MX 8 MQ Evaluation Kit
#@SOC: i.MX8
#@DESCRIPTION: Machine configuration for Voipac i.MX 8 MQ EVK
#@MAINTAINER: Marek Belisko <marek.belisko@voipac.com>

MACHINEOVERRIDES =. "imx8mq-lpddr4-wevk:"
require conf/machine/imx8mq-lpddr4-wevk.conf

PREFERRED_PROVIDER_virtual/kernel = "linux-imx"

UBOOT_CONFIG_BASENAME = "imx8mq_evk_voipac_config"

UBOOT_CONFIG ??= "sd"
UBOOT_CONFIG[sd] = "imx8mq_evk_voipac_config,sdcard"

KERNEL_DEVICETREE = " \
       freescale/imx8mq-evk-voipac-hdmi.dtb \
       freescale/imx8mq-evk-voipac-lvds-newhaven.dtb \
       freescale/imx8mq-evk-voipac-lvds-koe.dtb \
       freescale/imx8mq-evk-voipac-dp.dtb \
"
```

## meta-voipac-bsp/conf/machine/imx91-voipac.conf
```bitbake
#@TYPE: Machine
#@NAME: Voipac i.MX 91 Evaluation Kit
#@SOC: i.MX91
#@DESCRIPTION: Machine configuration for Voipac i.MX 91 EVK
#@MAINTAINER: Marek Belisko <marek.belisko@voipac.com>

MACHINEOVERRIDES =. "imx91-11x11-lpddr4x-evk:"
require conf/machine/imx91-11x11-lpddr4-evk.conf

PREFERRED_PROVIDER_virtual/kernel = "linux-imx"

KERNEL_DEVICETREE = "imx91-voipac-evk.dtb"

UBOOT_CONFIG_BASENAME = "imx91_voipac_evk"

SIGNED_TARGET:mx91-generic-bsp = "flash_singleboot"

KERNEL_DEVICETREE = " \
    freescale/imx91-voipac-evk.dtb \
"
```
