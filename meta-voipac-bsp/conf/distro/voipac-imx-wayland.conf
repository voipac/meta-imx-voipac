## meta-voipac-bsp/conf/distro/voipac-imx-wayland.conf
```bitbake
require conf/distro/poky.conf

DISTRO = "voipac-imx-wayland"
DISTRO_NAME = "VOIPAC DISTRO"
DISTRO_VERSION = "0.0.1"
DISTRO_CODENAME = "nanbield"

# Replace sysv with systemd
DISTRO_FEATURES += "systemd"
VIRTUAL-RUNTIME_init_manager = "systemd"
DISTRO_FEATURES:remove = " sysvinit bluetooth pcmcia wayland pulseaudio bluez5 pci ext2 irda nfc ptest 3g opengl directfb x11"
VIRTUAL-RUNTIME_initscripts = "systemd-compat-units"
DISTRO_FEATURES_BACKFILL_CONSIDERED += "sysvinit"

DISTRO_FEATURES:append = " wayland pam systemd usrmerge"

DISTROOVERRIDES = "fsl"

# Set a more generic tuning for code reuse across parts
DEFAULTTUNE:mx93-nxp-bsp   ?= "armv8a-crc-crypto"

PACKAGECONFIG:append:pn-gstreamer1.0-plugins-ugly = " x264"
```

## meta-voipac-bsp/conf/layer.conf
```bitbake
BBPATH .= ":${LAYERDIR}"

BBFILES += "${LAYERDIR}/recipes-*/*/*.bb \
            ${LAYERDIR}/recipes-*/*/*.bbappend"

# Dynamically add layer specific appends when those layers
# are available in bblayers.conf
BBFILES += "${@' '.join('${LAYERDIR}/%s/recipes*/*/*.bbappend' % layer \
               for layer in BBFILE_COLLECTIONS.split())}"

BBFILE_COLLECTIONS += "bsp-voipac-imx"
BBFILE_PATTERN_bsp-voipac-imx = "^${LAYERDIR}/"
BBFILE_PRIORITY_bsp-voipac-imx = "28"
LAYERDEPENDS_bsp-voipac-imx = " \
	freescale-distro \
	freescale-layer \
"

LAYERSERIES_COMPAT_bsp-voipac-imx = "nanbield scarthgap"
```

## meta-voipac-bsp/conf/machine/imx93-voipac.conf
```bitbake
#@TYPE: Machine
#@NAME: Voipac i.MX 93 Evaluation Kit
#@SOC: i.MX93
#@DESCRIPTION: Machine configuration for Voipac i.MX 93 EVK
#@MAINTAINER: Marek Belisko <marek.belisko@voipac.com>

MACHINEOVERRIDES =. "imx93-11x11-lpddr4x-evk:"
require conf/machine/imx93-11x11-lpddr4x-evk.conf

PREFERRED_PROVIDER_virtual/kernel = "linux-imx"

KERNEL_DEVICETREE = "imx93-voipac-evk.dtb"

UBOOT_CONFIG_BASENAME = "imx93_voipac_evk"

KERNEL_DEVICETREE = " \
    freescale/imx93-voipac-evk.dtb \
    freescale/imx93-voipac-evk-boe-wxga-lvds-panel.dtb \
"
```

## meta-voipac-evk/conf/layer.conf
```bitbake
BBPATH .= ":${LAYERDIR}"

BBFILES += "${LAYERDIR}/recipes-*/*/*.bb \
            ${LAYERDIR}/recipes-*/*/*.bbappend"

# Dynamically add layer specific appends when those layers
# are available in bblayers.conf
BBFILES += "${@' '.join('${LAYERDIR}/%s/recipes*/*/*.bbappend' % layer \
               for layer in BBFILE_COLLECTIONS.split())}"

BBFILE_COLLECTIONS += "evk-voipac-imx"
BBFILE_PATTERN_evk-voipac-imx = "^${LAYERDIR}/"
BBFILE_PRIORITY_evk-voipac-imx = "22"

LAYERSERIES_COMPAT_evk-voipac-imx = "nanbield scarthgap"
```
